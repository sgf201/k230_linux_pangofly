## buildroot-overlay/configs/k230_canmv_defconfig
```kconfig
# K230 CanMV Linux 配置

BR2_riscv=y
BR2_RISCV_64=y
BR2_RISCV_ISA_RVA=y
BR2_GCC_TARGET_ARCH="rv64gc"
BR2_GCC_TARGET_ABI="lp64d"

BR2_TOOLCHAIN_EXTERNAL=y
BR2_TOOLCHAIN_EXTERNAL_GDB_SERVER_COPY=y

BR2_ROOTFS_OVERLAY="$(TOPDIR)/buildroot-overlay/overlay"
BR2_LINUX_KERNEL=y
BR2_LINUX_KERNEL_CUSTOM_CONFIG_FILE="$(TOPDIR)/buildroot-overlay/linux.config"
BR2_TARGET_UBOOT=y
BR2_TARGET_UBOOT_CUSTOM_CONFIG_FILE="$(TOPDIR)/buildroot-overlay/uboot.config"

# Pangofly 集成
BR2_PACKAGE_PANGOFLY=y
```

## buildroot-overlay/package/pangofly/Config.in
```kconfig
config BR2_PACKAGE_PANGOFLY
	bool "pangofly"
	help
	  Pangofly shared memory communication library for RT-Smart and Linux
```

## buildroot-overlay/package/pangofly_gesture/Config.in
```kconfig
config BR2_PACKAGE_PANGOFLY_GESTURE
    bool "pangofly_gesture"
    depends on BR2_PACKAGE_PANGOFLY
    help
      Gesture recognition application using Pangofly communication
```
